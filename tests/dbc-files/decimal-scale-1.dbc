VERSION "SingleFrame1.dbc"

NS_ :

BS_:

BU_: TestNode

BO_ 1296 TEST_FRAME_1: 2 TestNode
	SG_ TEST_SIG_1 : 0|8@1+ (1.0,0) [0|0] "" TestNode
	SG_ TEST_SIG_2 : 8|8@1+ (0.1,0) [0|0] "" TestNode
